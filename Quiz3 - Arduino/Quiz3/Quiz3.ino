#include <FastLED.h>
#include <Wire.h>
#include <String.h>

/*----------------------------------------------------------------------------------------*/

#define DATA_PIN 3 // Serial pin 
#define MIN_PIN 9
#define HR_PIN 8

#define LCD_NUM 5
#define MAX_CHR 20

/*----------------------------------------------------------------------------------------*/

CRGB leds[LCD_NUM * 8 * 8];
int binary_result[MAX_CHR][64];
bool display_time = false;
byte second, minute, hour, year, date, month;

uint8_t alphabets[855]={ 
    0x20, 0x00, 0x00, 0x00, 0x00, 0x00, 0x00, 0x00, 0x00,   // 
    0x21, 0x18, 0x3c, 0x3c, 0x18, 0x18, 0x00, 0x18, 0x00,   //>! 
    0x22, 0x6c, 0x6c, 0x00, 0x00, 0x00, 0x00, 0x00, 0x00,   //" 
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    0x7e, 0x76, 0xdc, 0x00, 0x00, 0x00, 0x00, 0x00, 0x00,   //~ 
}; 

/*----------------------------------------------------------------------------------------*/

void get_binary_array(int number, int binary_arr[8]) {
    int i = 7;
    while (i >= 0) {
        binary_arr[i] = number % 2;
        number /= 2;
        i--;
    }
}

void string_to_pixel_array (String name) {
    for (int i = 0; i < name.length(); i++) {
        int j = ((int) name[i] - 0x20) * 9; // Index of alphabets
        for (int r = 0; r < 8; ++r) {
            int binary_arr[8];
            get_binary_array (alphabets[j + r + 1], binary_arr);
            for (int c = 0; c < 8; ++c) {
                binary_result[i][r * 8 + c] = binary_arr[c];
            }
        }
    }
}

void display() {
    for(int i = 0; i < 5; ++i){
        for(int j = 0; j < 64; ++j){
            if(binary_result[i][j] == 1) {
                leds[i * 64 + j] = CRGB::Red;
            } else {
                leds[i * 64 + j] = CRGB::Black;
            }
        }
    }
}
  
void setup() { 
    FastLED.addLeds<NEOPIXEL, DATA_PIN>(leds, LCD_NUM * 8 * 8);
    FastLED.setBrightness(255);
    
    Wire.begin(); // for clock
    
    pinMode(HR_PIN, INPUT_PULLUP);
    pinMode(MIN_PIN, INPUT_PULLUP);
    
    string_to_pixel_array("AmirHossein");
}

void shift_left(){
    bool flag = false;
    for(int i = 0; i < MAX_CHR; ++i) {
        for(int j = 0; j < 64; ++j){
            if (j % 8 == 7) {
                binary_result[i][j] = binary_result[i + 1][j - 7];
            } else {
                binary_result[i][j] = binary_result[i][j + 1];
            }

            if (binary_result[i][j] == 1) {
                flag = true;
            }
        }
    }

    if (!flag)
        display_time = true;
}

String time_to_string(int h, int m) {
    char buffer[MAX_CHR];
    String res = "";

    // hour
    if (h < 10) res += "0";
    itoa(h, buffer, 10);
    res += buffer;
    res += ":";

    // minute
    if (m < 10) res += "0";
    itoa(m, buffer, 10);
    res += buffer;
    
    return res;
}

void loop() {
    if (!display_time) {
        shift_left();
    } else {
        get_time_details();
        
        if(!digitalRead(HR_PIN)) {
            while(!digitalRead(HR_PIN)){}
            increase_hour_value();
        }
        
        if(!digitalRead(MIN_PIN)) {
            while(!digitalRead(MIN_PIN)){}
            increase_minute_value();
        }
        
        string_to_pixel_array(time_to_string((int) hour, (int) minute));
    }
    
    display();

    FastLED.show();
    delay(10);   
}

void increase_minute_value() {
    if ((int)minute + 1 == 60) {
        minute = 0;
        hour++;
    } else {
        minute += 1;
    }
    if (hour == 24){
        hour =0 ;
    }
    minute = ((minute / 10) << 4) + (minute % 10);
    hour = ((hour / 10) << 4) + (hour % 10);

    
    Wire.beginTransmission(0x68);               // Start I2C protocol with DS1307 address
    Wire.write(0);                              // Send register address
    Wire.write(0);                              // Reset sesonds and start oscillator
    Wire.write(minute);                         // Write minute
    Wire.write(hour);                           // Write hour
    Wire.write(1);                              // Write day (not used)
    Wire.write(date);                           // Write date
    Wire.write(month);                          // Write month
    Wire.write(year);                           // Write year
    Wire.endTransmission();                     // Stop transmission and release the I2C bus
}

void increase_hour_value() {
    if ((int)hour + 1 == 24) {
        hour = 0;
    } else {
        hour += 1;
    }
    minute = ((minute / 10) << 4) + (minute % 10);
    hour = ((hour / 10) << 4) + (hour % 10);

    
    Wire.beginTransmission(0x68);               // Start I2C protocol with DS1307 address
    Wire.write(0);                              // Send register address
    Wire.write(0);                              // Reset sesonds and start oscillator
    Wire.write(minute);                         // Write minute
    Wire.write(hour);                           // Write hour
    Wire.write(1);                              // Write day (not used)
    Wire.write(date);                           // Write date
    Wire.write(month);                          // Write month
    Wire.write(year);                           // Write year
    Wire.endTransmission();                     // Stop transmission and release the I2C bus
}

void get_time_details() {
    Wire.beginTransmission(0x68);                 // Start I2C protocol with DS1307 address
    Wire.write(0);                                // Send register address
    Wire.endTransmission(false);                  // I2C restart
    Wire.requestFrom(0x68, 7);                    // Request 7 bytes from DS1307 and release I2C bus at end of reading
    second = Wire.read(); 
    minute = Wire.read();                         // Read minuts from register 1
    hour   = Wire.read();                         // Read hour from register 2
    Wire.read();      
    
    //BCD to Decimal 
    minute = (minute >> 4) * 10 + (minute & 0x0F);
    hour   = (hour >> 4)   * 10 + (hour & 0x0F);
}
